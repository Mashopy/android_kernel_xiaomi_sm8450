## drivers/input/touchscreen/fts_spi/Kconfig
```kconfig
config TOUCHSCREEN_ST_FTS_V521_SPI
	tristate "ST FTS V521 I2C Touchscreen"
	depends on I2C
	help
	  Say Y here if you have ST FTS series I2C touchscreen.

	  If unsure, say N.

	  To compile this driver as a module, choose M here: the

config TOUCHSCREEN_FTS_SPI_XIAOMI_L12
	bool "ST FTS Touchscreen Xiaomi L12 changes"
	depends on TOUCHSCREEN_ST_FTS_V521_SPI
	default n
	help
		Say Y here if you build for Xiaomi L12 (diting).

		If unsure, say N.
```
